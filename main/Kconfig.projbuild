## main/Kconfig.projbuild
```kconfig
menu "App config"

config APP_WIFI_SSID
    string "WiFi SSID"
    default ""

config APP_WIFI_PASSWORD
    string "WiFi password"
    default ""

config APP_OTA_SERVER
    string "OTA server host"
    default ""

endmenu
```
